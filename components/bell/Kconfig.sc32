## components/bell/Kconfig.sc32
```kconfig
menu "Audio output (VS1053)"

    config GPIO_VS_CS
        int "VS1053 XCS (command) GPIO"
        range 0 48
        default 17
    config GPIO_VS_DCS
        int "VS1053 XDCS (data) GPIO"
        range 0 48
        default 7
    config GPIO_VS_RESET
        int "VS1053 XRESET GPIO (-1 = not connected)"
        range -1 48
        default 16
    config GPIO_VS_DREQ
        int "VS1053 DREQ GPIO"
        range 0 48
        default 15

    menu "VS1053 SPI bus"
        config GPIO_HSPI_MOSI
            int "MOSI GPIO"
            default 5
        config GPIO_HSPI_MISO
            int "MISO GPIO"
            default 6
        config GPIO_HSPI_CLK
            int "CLK GPIO"
            default 4
    endmenu

    config VS_SPI_HOST
        int
        default 1   # SPI2_HOST

    config STREAM_BUFFER_SIZE
        int "Audio buffer per stream (bytes)"
        range 16384 524288
        default 81920
        help
            Ring buffer between a stream and the decoder (PSRAM).  A multiple
            of 1024 is recommended.

    config REPORT_ON_SCREEN
        bool "Log decoder statistics (bitrate, format) while playing"
        default n

    # the VS1053 decodes everything itself
    config AUDIO_SINK_VS1053
        bool
        default y
    config BELL_NOCODEC
        bool
        default y

endmenu
```

## components/bq27220/Kconfig.sc32
```kconfig
menuconfig SC32_BATTERY
    bool "Battery fuel gauge (BQ27220)"
    default y

if SC32_BATTERY
    config BQ27220_I2C_ADDR
        hex "I2C address"
        default 0x55
    config BQ27220_LOG_VALUES
        bool "Log every reading"
        default n
endif
```

## components/eink_vg/Kconfig.sc32
```kconfig
menu "Icons (eink_vg)"
    config EINK_VG_BOX_W
        int "SVG scale-to-fit box width (px)"
        range 8 256
        default 64
    config EINK_VG_BOX_H
        int "SVG scale-to-fit box height (px)"
        range 8 256
        default 64
endmenu
```

## components/ft6x36/Kconfig.sc32
```kconfig
menuconfig SC32_TOUCH
    bool "Touch panel (FT6X36)"
    default y
    depends on SC32_DISPLAY_EINK

if SC32_TOUCH
    config GPIO_TOUCH_INT
        int "INT GPIO"
        default 3
    config GPIO_TOUCH_RESET
        int "RESET GPIO"
        default 46
endif
```

## components/gdey027t91/Kconfig.sc32
```kconfig
menuconfig SC32_DISPLAY_EINK
    bool "E-paper display (GDEY027T91) with touch UI"
    default y
    help
        2.7" e-paper with the on-device user interface.  Without it the
        device is controlled by the streaming apps and the web UI only.

if SC32_DISPLAY_EINK
    config GPIO_EINK_CS
        int "CS GPIO"
        default 9
    config GPIO_EINK_DC
        int "DC GPIO"
        default 18
    config GPIO_EINK_RESET
        int "RESET GPIO"
        default 48
    config GPIO_EINK_BUSY
        int "BUSY GPIO"
        default 47
    config GPIO_VSPI_MOSI
        int "SPI MOSI GPIO"
        default 41
    config GPIO_VSPI_CLK
        int "SPI CLK GPIO"
        default 40

    orsource "../eink_vg/Kconfig.sc32"
endif
```

## components/i2c_bus/Kconfig.sc32
```kconfig
menu "I2C bus"
    depends on SC32_TOUCH || SC32_BATTERY
    config GPIO_SDA
        int "SDA GPIO"
        default 2
    config GPIO_SCL
        int "SCL GPIO"
        default 1
endmenu
```

## components/sc_app/Kconfig.led
```kconfig
menuconfig SC32_STATUS_LED
    bool "Status LED (SK6812 / WS2812, RMT)"
    default y
    help
        One addressable RGB LED showing WiFi / streaming state.  Colours,
        brightness and mode can be changed in the settings.

if SC32_STATUS_LED
    config GPIO_LED_DATA
        int "LED data GPIO"
        default 8

    choice SC32_LED_MODE_DEFAULT
        prompt "Default mode"
        default SC32_LED_MODE_ALL
        config SC32_LED_MODE_OFF
            bool "Off (the LED is never written)"
        config SC32_LED_MODE_STARTUP
            bool "Only while WiFi starts"
        config SC32_LED_MODE_WIFI
            bool "WiFi status only"
        config SC32_LED_MODE_ALL
            bool "All states (WiFi + streaming services)"
    endchoice
    config SC32_LED_MODE
        int
        default 0 if SC32_LED_MODE_OFF
        default 1 if SC32_LED_MODE_STARTUP
        default 2 if SC32_LED_MODE_WIFI
        default 3

    config SC32_LED_BRIGHTNESS
        int "Default brightness (%)"
        range 1 100
        default 20
endif
```

## components/sc_app/Kconfig.sc32
```kconfig
menu "Device"
    config SC32_DEVICE_NAME
        string "Device name"
        default "StreamCore32"
        help
            Name the device announces itself with: Spotify Connect, Qobuz
            Connect, DLNA, mDNS (http://<name>.local/, so better without
            spaces) and the web UI.  Can be changed at runtime
            in the settings (web UI or display); that value is kept in NVS
            and wins over this default.

    config WIFI_SSID
        string "Default WiFi network (SSID)"
        default "SSID"
        help
            Used until a network is set in the web UI / on the display.
    config WIFI_PASSWORD
        string "Default WiFi password"
        default "password"
endmenu
```

## components/sc_dlna/Kconfig.sc32
```kconfig
menuconfig SC32_DLNA
    bool "DLNA / UPnP renderer"
    default y
    help
        The device shows up as a DLNA / UPnP AV media renderer: control
        points (BubbleUPnP, Hi-Fi Cast, foobar2000, JRiver, Kodi, Plex /
        Jellyfin, ...) send it music from a media server or the phone.
        Plays MP3, AAC, FLAC, Ogg Vorbis, WAV, WMA and LPCM (audio/L16),
        seeks in files, plays gap-less (SetNextAVTransportURI).
        Can be switched off in the settings.

if SC32_DLNA
    config SC32_DLNA_PORT
        int "HTTP port of the renderer"
        range 1024 65535
        default 49152
        help
            Description, control and event URLs are served here
            (the web UI stays on port 80). SSDP uses UDP 1900.
endif
```

## components/sc_qobuz/Kconfig.sc32
```kconfig
menuconfig SC32_QOBUZ
    bool "Qobuz Connect"
    default y
    help
        Qobuz Connect receiver.  Can also be switched off at runtime in the
        settings.

if SC32_QOBUZ
    choice QOBUZ_QUALITY
        prompt "Default audio quality"
        default QOBUZ_HIRES_96
        config QOBUZ_MP3
            bool "MP3 320 kbps"
        config QOBUZ_CD
            bool "FLAC 16 bit / 44.1 kHz"
        config QOBUZ_HIRES_96
            bool "FLAC hi-res up to 96 kHz"
        config QOBUZ_HIRES_192
            bool "FLAC hi-res up to 192 kHz"
    endchoice
    config QOBUZ_AUDIO_FORMAT
        int
        default 5 if QOBUZ_MP3
        default 6 if QOBUZ_CD
        default 7 if QOBUZ_HIRES_96
        default 27 if QOBUZ_HIRES_192
endif
```

## components/sc_sdcard/Kconfig.sc32
```kconfig
menuconfig SC32_SDCARD
    bool "SD card (SDMMC, 1-bit)"
    default y
    help
        micro SD card mounted at /sdcard: file player, playlists, file
        manager in the web UI, crash reports.

if SC32_SDCARD
    config GPIO_SD_CMD
        int "CMD GPIO"
        default 13
    config GPIO_SD_CLK
        int "CLK GPIO"
        default 12
    config GPIO_SD_D0
        int "D0 GPIO"
        default 11
    config GPIO_SD_CD
        int "Card detect GPIO (-1 = none)"
        range -1 48
        default 14
        help
            Card detect switch of the socket (closes to GND when a card is
            inserted).  -1 if the socket has no detect pin.
endif
```

## components/sc_sdfile/Kconfig.sc32
```kconfig
config SC32_SDFILE
    bool "SD card player"
    default y
    depends on SC32_SDCARD
    help
        Plays audio files and M3U playlists from the SD card.
```

## components/sc_spotify/Kconfig.sc32
```kconfig
menuconfig SC32_SPOTIFY
    bool "Spotify Connect"
    default y
    help
        Spotify Connect receiver (zeroconf login from the Spotify app).
        Can also be switched off at runtime in the settings.

if SC32_SPOTIFY

    choice SPOTIFY_QUALITY
        prompt "Default audio quality"
        default VORBIS_160
        help
            Default for the "Spotify quality" setting (changeable at runtime).
        config VORBIS_96
            bool "Ogg Vorbis 96 kbps"
        config VORBIS_160
            bool "Ogg Vorbis 160 kbps"
        config VORBIS_320
            bool "Ogg Vorbis 320 kbps"
    endchoice

    config SPOTIFY_AUDIO_FORMAT
        int
        default 0 if VORBIS_96
        default 1 if VORBIS_160
        default 2 if VORBIS_320

    config SPOTIFY_DISCOVERY_MODE_OPEN
        bool "Stay visible while connected"
        default y
        help
            Keep the mDNS announcement active while a client is connected, so
            playback can be transferred from another device without
            disconnecting first.

    config SPOTIFY_CLIENT_ID
        string "Client ID"
        default ""
        help
            Client ID of a Spotify developer app (developer.spotify.com), needed
            to fetch the audio files (see components/sc_spotify/README.md).
            Stays in your local sdkconfig.
    config SPOTIFY_CLIENT_SECRET
        string "Client secret"
        default ""
        help
            Client secret of the same app.

endif
```

## components/sc_webstream/Kconfig.sc32
```kconfig
config SC32_WEBSTREAM
    bool "Internet radio"
    default y
    help
        Plays internet radio streams (station list in the web UI / display).
```
